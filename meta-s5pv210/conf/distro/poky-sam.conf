## meta-s5pv210/conf/distro/poky-sam.conf
```bitbake
require conf/distro/poky.conf

DISTRO = "poky-sam"
DISTRO_NAME = "Samsung s5pv210 "
DISTRO_VERSION = "sam-${DATE}"
DISTRO_CODENAME = "s5pv210"

MAINTAINER = "Armin Kuster  <akuster808@gmail.com>"

TARGET_VENDOR = "-sam"

#PREFERRED_VERSION_linux-samsung = "3.17%"
```

## meta-s5pv210/conf/layer.conf
```bitbake
# We have a conf and classes directory, add to BBPATH
BBPATH .= ":${LAYERDIR}"

# We have a recipes-* directories, add to BBFILES
BBFILES += "${LAYERDIR}/recipes-*/*/*.bb \
	        ${LAYERDIR}/recipes-*/*/*.bbappend"

BBFILE_COLLECTIONS += "s5pv210"
BBFILE_PATTERN_s5pv210 := "^${LAYERDIR}/"
BBFILE_PRIORITY_s5pv210 = "5"

LAYERVERSION_s5pv210 = "1"
```

## meta-s5pv210/conf/machine/samsung-s5pv210.conf
```bitbake
#@TYPE: Machine
#@NAME: samsung-s5pv210
#@DESCRIPTION: Machine configuration for Samsun s5pv210 systems
#@MAINTAINER: Armin Kuster <akuster808@gmail>

PREFERRED_PROVIDER_virtual/xserver ?= "xserver-xorg"
XSERVER ?= "xserver-xorg \
           xf86-input-evdev \
           xf86-input-mouse \
           xf86-video-omapfb \
           xf86-input-keyboard"

# Ship all kernel modules by default
MACHINE_EXTRA_RRECOMMENDS = " kernel-modules"

DEFAULTTUNE ?= "cortexa8hf-neon"
include conf/machine/include/tune-cortexa8.inc

IMAGE_FSTYPES += "tar.bz2 jffs2"

# earlier kernels use ttySAC1
SERIAL_CONSOLE = "115200 ttySAC1"


PREFERRED_PROVIDER_virtual/kernel ?= "linux-samsung"

KERNEL_IMAGETYPE = "zImage"
KERNEL_DEVICETREE = "${S}/arch/arm/boot/dts/s5pv210-smdkv210.dts"

MACHINE_FEATURES = "usbgadget usbhost vfat alsa touchscreen"
```
